## system/buildroot/external/Config.in
```kconfig
menu "PhoneOS packages"
    source "$BR2_EXTERNAL_PHONEOS_PATH/package/phoneos/Config.in"
endmenu
```

## system/buildroot/external/package/phoneos/Config.in
```kconfig
config BR2_PACKAGE_PHONEOS
    bool "phoneos launcher"
    select BR2_PACKAGE_LVGL
    select BR2_PACKAGE_LV_DRIVERS
    help
      Lightweight smartphone shell and app framework using LVGL.
```

## system/buildroot/phoneos_zero2w_defconfig
```kconfig
BR2_arm=y
BR2_cortex_a53=y
BR2_ARM_EABIHF=y
BR2_TOOLCHAIN_BUILDROOT_MUSL=y
BR2_TOOLCHAIN_BUILDROOT_GLIBC=n
BR2_TARGET_GENERIC_HOSTNAME="phoneos"
BR2_TARGET_GENERIC_ISSUE="PhoneOS Buildroot"
BR2_ROOTFS_OVERLAY="$(BR2_EXTERNAL_PHONEOS_PATH)/board/phoneos/rootfs-overlay"
BR2_ROOTFS_POST_BUILD_SCRIPT="$(BR2_EXTERNAL_PHONEOS_PATH)/board/phoneos/post-build.sh"

BR2_LINUX_KERNEL=y
BR2_LINUX_KERNEL_CUSTOM_VERSION=y
BR2_LINUX_KERNEL_CUSTOM_VERSION_VALUE="6.6.32"
BR2_LINUX_KERNEL_DEFCONFIG="bcm2709"
BR2_LINUX_KERNEL_DTS_SUPPORT=y
BR2_LINUX_KERNEL_INTREE_DTS_NAME="broadcom/bcm2710-rpi-zero-2"

BR2_PACKAGE_RPI_FIRMWARE=y
BR2_PACKAGE_RPI_FIRMWARE_VARIANT_PI=y
BR2_PACKAGE_RPI_FIRMWARE_CONFIG_FILE="$(BR2_EXTERNAL_PHONEOS_PATH)/board/phoneos/config.txt"
BR2_PACKAGE_RPI_FIRMWARE_CMDLINE_FILE="$(BR2_EXTERNAL_PHONEOS_PATH)/board/phoneos/cmdline.txt"

BR2_TARGET_ROOTFS_EXT2=y
BR2_TARGET_ROOTFS_EXT2_4=y
BR2_TARGET_ROOTFS_EXT2_SIZE="512M"
BR2_TARGET_ROOTFS_TAR=y

BR2_PACKAGE_LVGL=y
BR2_PACKAGE_LV_DRIVERS=y
BR2_PACKAGE_KMSXX=n
BR2_PACKAGE_LIBDRM=n
BR2_PACKAGE_FFMPEG=n

BR2_PACKAGE_PHONEOS=y

BR2_PACKAGE_TSLIB=y
BR2_PACKAGE_EVTEST=y
BR2_PACKAGE_I2C_TOOLS=y

BR2_SYSTEM_DHCP="eth0"
```
